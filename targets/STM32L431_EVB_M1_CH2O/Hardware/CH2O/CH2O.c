/********************************************************************************
    * 文件名称 ：CH2O.c
    * 作     者：物联网俱乐部
    * 版     本：V1.0
    * 编写日期 ：2019-1-1
    * 功     能：EVB_M/H 甲醛扩展板驱动
*********************************************************************************
    * 说    明 ：本例程配套物联网俱乐部EVB_M1开发板使用
    *
    * 淘     宝：https://shop128001708.taobao.com/
    * 论     坛：bbs.iot-club.cn
*********************************************************************************/
#include "CH2O.h"
#include "usart.h"

/**********************************************************************
* 函数名: float ZE08ch2o(uint8_t Buffer[]) 
* 功能描述:计算甲醛浓度
* 函数说明:计算浓度后返回浓度的值
**********************************************************************/
float ZE08ch2o(uint8_t Buffer[])
{
	if(FucCheckSum(Buffer,9)==Buffer[8])
	{
		float value;
		if(Buffer[0]==0xff)//起始位为0xff
		{
			if(Buffer[1]==0x17)
			{
			//甲醛  模式主动上传
					if(Buffer[2]==0x04)
					{
						//确认单位为ppb
						value=(Buffer[4]*256+Buffer[5])/1000.0;
					}
			}																
		}
			return value;
	}
	else
	{
			return -1;
	}
}

/**********************************************************************
* 函数名: unsigned char FucCheckSum(uchar *i,ucharln) 
* 功能描述:求和校验（取发送、接收协议的1\2\3\4\5\6\7的和取反+1）
* 函数说明:将数组的元素1-倒数第二个元素相加后取反+1（元素个数必须大于2）
**********************************************************************/
unsigned char FucCheckSum(unsigned char *i,unsigned char ln)
{ 
unsigned char j,tempq=0;
i+=1;
for(j=0;j<(ln-2);j++)
{
tempq+=*i;
i++;
}
tempq=(~tempq)+1;
return(tempq);
}
